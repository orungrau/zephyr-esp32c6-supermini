## boards/others/esp32c6_supermini/Kconfig
```kconfig
# SPDX-License-Identifier: Apache-2.0

config SOC_PART_NUMBER
	default "ESP32-C6FH4" if BOARD_ESP32C6_SUPERMINI

config HEAP_MEM_POOL_ADD_SIZE_BOARD
	int
	default 4096 if BOARD_ESP32C6_SUPERMINI_ESP32C6_HPCORE
	default 256 if BOARD_ESP32C6_SUPERMINI_ESP32C6_LPCORE
```

## boards/others/esp32c6_supermini/Kconfig.esp32c6_supermini
```kconfig
# SPDX-License-Identifier: Apache-2.0

config BOARD_ESP32C6_SUPERMINI
	select SOC_ESP32C6
	select SOC_ESP32C6_HPCORE if BOARD_ESP32C6_SUPERMINI_ESP32C6_HPCORE
	select SOC_ESP32C6_LPCORE if BOARD_ESP32C6_SUPERMINI_ESP32C6_LPCORE
```

## boards/others/esp32c6_supermini/board.yml
```yaml
# SPDX-License-Identifier: Apache-2.0

board:
  name: esp32c6_supermini
  full_name: ESP32-C6 Super Mini
  vendor: others
  socs:
    - name: esp32c6
```
